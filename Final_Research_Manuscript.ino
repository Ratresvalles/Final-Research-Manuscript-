
/*ARDUINO PINS revised

  ANALOG pins
  A0 ACOLL IRSR                        //  input  for  ir  snsr SPST                 // Internal power
  A1 GRND IRSR                         //  input  for  ir  snsr SPST                 // Internal power
  A2 URCN IRSR                         //  input  for  ir  snsr SPST                 // Internal power
  A3 EMGY BTON                         //  input  for tgle swch SPDT                 // Internal power
  A4 OLED SCRN                         //  output for OLED SCRN SDA                  // Internal power
  A5 OLED SCRN                         //  output for OLED SCRN SCK                  // Internal power

  DIGITAL pins
  13 BCOLL IRSR                        //  input  for  ir  snsr SPST                 // Internal power
  12 CCOLL IRSR                        //  input  for  ir  snsr SPST                 // Internal power
  11 GSM                               //  output for GSMm RXD                       // External power
  10 GSM                               //  output for GSMm TXD                       // External power
  9                          
  8  COLL                              //  output for  12V DC COLLECTOR MOTOR        // External power
  7  GRND                              //  output for 220V AC GRINDING  MOTOR        // External power
  6  MNLO                              //  input  for tgle swch SPST                 // Internal power
  5  DCOLL IRSR                        //  input  for  ir  snsr SPST                 // Internal power
  4  OLED SCRN RESET PIN               //  NO pin. Reserve only for OLED SCRN reset  // No power needed
  3  BUZZER                            //  OUTPUT for buzzer                         // Internal power
  2                                    //  NONE                                      // No power needed
  1                                    //  NONE                                      // No power needed
  ---------------------------------------------------------------------------------------------------------
*/
#include <Servo.h>
#include <SoftwareSerial.h>
#include <SPI.h>
#include <Wire.h>
#include <Adafruit_GFX.h>
#include <Adafruit_SSD1306.h>
#define s_w   128                                //  OLED SCRN display width, in pixels
#define s_h    32                                //  OLED SCRN display height, in pixels#define o_r     
#define o_r     4                                //  Reset pin # 4 (or -1 if sharing Arduino reset pin)
Adafruit_SSD1306 display(s_w, s_h, &Wire, o_r);
#define g        A0                              //  input  ir  snsr SPST grnd
#define ac       A1                              //  input  ir  snsr SPST acoll
#define u        A2                              //  input  ir  snsr SPST urne
#define e        A3                              //  input tgle swch SPDT emgy
/*
OLED SCRN        A4                              //  output SDA
OLED SCRN        A5                              //  output SCK */
#define bc      13                               //  input  ir  snsr SPST bcoll
#define cc      12                               //  input  ir  snsr SPST ccoll
#define cl       8                               //  output for c 12V  DC motor relay
#define gr       7                               //  output for g 22OV AC motor relay  
#define m        6                               //  input  for manual oprtn of g & c motors
#define dc       5                               //  input  ir  snsr SPST dcoll
#define bz       3                               //  output for bz
String defnum = "+639957183717";                 // 1st researcher's number
SoftwareSerial sim(10, 11);                      //  output for GSMm 10 to TXD, 11 to RXD
int acs, bcs, ccs, dcs, gs, us, en, mn;

// Animation for loading
const unsigned char PROGMEM frame0 [] = {0x00, 0x00, 0x00, 0x00, 0x00, 0x60, 0x00, 0x00, 0x00, 0xF0, 0x00, 0x00, 0x00,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 0x00, 0x00};
const unsigned char PROGMEM frame1 [] = {0x00, 0x00, 0x00, 0x00, 0x00, 0x00, 0x00, 0x00, 0x00, 0x60, 0x00, 0x00, 0x00,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 0x70, 0x00};
const unsigned char PROGMEM frame2 [] = {0x00, 0x00, 0x00, 0x00, 0x00, 0x00, 0x00, 0x00, 0x00, 0x20, 0x00, 0x00, 0x00,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 0x00, 0x00};
const unsigned char PROGMEM frame3 [] = {0x00, 0x00, 0x00, 0x00, 0x00, 0x00, 0x00, 0x00, 0x00, 0x60, 0x00, 0x00, 0x00,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 0x00, 0x00};
const unsigned char PROGMEM frame4 [] = {0x00, 0x00, 0x00, 0x00, 0x00, 0x00, 0x00, 0x00, 0x00, 0x60, 0x00, 0x00, 0x00,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 0x00, 0x00};
const unsigned char PROGMEM frame5 [] = {0x00, 0x00, 0x00, 0x00, 0x00, 0x00, 0x00, 0x00, 0x00, 0x60, 0x40, 0x00, 0x00,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 0x00, 0x00};
const unsigned char PROGMEM frame6 [] = {0x00, 0x60, 0x00, 0x00, 0x01, 0xF8, 0x00, 0x00, 0x01, 0xF8, 0x00, 0x00, 0x03,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 0x00, 0x00};
const unsigned char PROGMEM frame7 [] = {0x00, 0x00, 0x00, 0x00, 0x00, 0xF0, 0x00, 0x00, 0x01, 0xF8, 0x00, 0x00, 0x01,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 0x00, 0x00};

// Animation for hazard
const unsigned char PROGMEM hazard0 [] = {0x00, 0x00, 0x00, 0x00, 0x00, 0x00, 0x00, 0x00, 0x00, 0x00, 0x00, 0x00, 0x00,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 0x00, 0x00};
const unsigned char PROGMEM hazard1 [] = {0x00, 0x00, 0x00, 0x00, 0x00, 0x00, 0x00, 0x00, 0x00, 0x00, 0x00, 0x00, 0x00,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 0x00, 0x00};
const unsigned char PROGMEM hazard2 [] = {0x00, 0x00, 0x00, 0x00, 0x00, 0x00, 0x00, 0x00, 0x00, 0x00, 0x00, 0x00, 0x00,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 0x00, 0x00};
const unsigned char PROGMEM hazard3 [] = {0x00, 0x00, 0x00, 0x00, 0x00, 0x00, 0x00, 0x00, 0x00, 0x00, 0x00, 0x00, 0x00,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 0x00, 0x00};
const unsigned char PROGMEM hazard4 [] = {0x00, 0x00, 0x00, 0x00, 0x00, 0x00, 0x00, 0x00, 0x00, 0x00, 0x00, 0x00, 0x00,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 0x00, 0x00};
const unsigned char PROGMEM hazard5 [] = {0x00, 0x00, 0x00, 0x00, 0x00, 0x00, 0x00, 0x00, 0x00, 0x00, 0x00, 0x00, 0x00,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 0x00, 0x00};
const unsigned char PROGMEM hazard6 [] = {0x00, 0x00, 0x00, 0x00, 0x00, 0x00, 0x00, 0x00, 0x00, 0x00, 0x00, 0x00, 0x00,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 0x00, 0x00};

void setup() {
  delay(3000);
  sim.begin(9600);
  r ("System initializing.");
  pinMode (u, INPUT_PULLUP);


pinMode (ac, INPUT_PULLUP);
  pinMode (bc, INPUT_PULLUP);
  pinMode (cc, INPUT_PULLUP);
  pinMode (dc, INPUT_PULLUP);
  pinMode (g, INPUT_PULLUP);
  pinMode (e, INPUT_PULLUP);
  pinMode (m, INPUT_PULLUP);
  pinMode (cl, OUTPUT);
  pinMode (gr, OUTPUT);
  pinMode (bz, OUTPUT);
  tone(bz, 3950, 1500);
  digitalWrite (gr, HIGH);
  digitalWrite (cl, HIGH);
  {
    if (!display.begin(SSD1306_SWITCHCAPVCC, 0x3C)) {}

// loading bar
    for (int i = 15; i <= 114; i++)
    { display.clearDisplay();
      display.drawRoundRect(6, 9, 120, 20, 10 , WHITE);
      display.fillRoundRect(9, 12, i, 14, 10, WHITE);
      display.display();
      delay(500);
    }
    r ("I'm ready for any operation.");
    s(" SYSTEM ");
    delay(1000);
    s("INITIALZE");
    delay(1000);
  }
}
void loop()
{
  int us  = digitalRead(u);
  int acs = digitalRead(ac);
  int bcs = digitalRead(bc);
  int ccs = digitalRead(cc);
  int dcs = digitalRead(dc);
  int gs  = digitalRead(g);
  int en  = digitalRead(e);
  int mn  = digitalRead(m);

  //URNE IRSR---------------------------------------------if actv need to empty the URNE STRG as soon as possible.

  if (us == LOW) {
    // BUZZER WARNING_____________________   
    bzwi ();     
    // OLED SCRN______________________
   s("URNE FULL");

    // BUZZER WARNING_____________________
    bzwo ();

    // GSMm NOTF______________________
    for (int i = 1; i <= 6; i++) {
      r("URNE strg is full pls rmv 'ASAP'.");
      
      s("URNE FULL");
      delay(600000);
      
    }           // wait for 10mins\600000 or 5mins\300000 for SENTing another sms notf.
    while (2) {
      
s("URNE FULL");
delay(1000);
wl ();
      }
    
  }               // For deactivating the loop if the user did not remove the content of URNE STRG.
  // To reactivate the loop it need to remove the content of container to
  // reset the system and be operational.

  //COLL IRSR------------------------------------------------ if actv, automatic prcs no physical contact needed.

  else if (acs == LOW || bcs == LOW  || ccs == LOW || dcs == LOW) {


    // OLED SCRN_____________________
     s("COLL STRT");
    delay(500);               // .5 sec

    // GSMm NOTF_____________________
      r("coll started.");
    delay(1000);              // 1 sec

    // BUZZER WARNING____________________
   bzwi ();             // 320 milisec
    delay(2000);              // 2 sec delay for coll motr activation

    // COLL MOTR ACTV____________________
    digitalWrite (cl, LOW);
    delay(90000);              // 1 minute 30 seconds of operating : for simulation purposes only
    // its may change for the actual testing on the site.
    digitalWrite (cl, HIGH);  // For deactivation after operating.
    delay(500);

    // OLED SCRN_____________________
     s("COLL DONE");
    delay(500);               // 0.5 sec

    // BUZZER WARNING____________________
    bzwo ();            // 1 sec

    // GSMm NOTF____SENTing 3 SMS notf every 2mins.
    for (int i = 1; i <= 3; i++) {
    r("coll done.");
      delay(120000); //2mins \ 120000
    }
    
for (int i = 1; i <= 10; i++) {
 tone(bz, 3950, 1000);
  s("COLL DONE");
delay(1000);
  wl ();
}      
    }
  

  //EMGY BTON----------Physical contact needed and for instant deactivation during every process or in no process.

  else if (en == LOW) {


// Deactivating AC-DC motors__________________
    digitalWrite (gr, HIGH);
    digitalWrite (cl, HIGH);

    // OLED SCRN _____________________
    s("EMGY STOP");

    // BUZZER WARNING_____________________
    for (int i = 1; i <= 10; i++) {
      tone(bz, 3950, 300);
      delay(400);
    }              // 400 milisec

    // GSMm NOTF______________________
    r("EMGY STOP: ALL PRCSS SHALL NOT BE ACTIVATED.");

    // OLED SCRN ____________________
    s(" SMS SENT");
    tone(bz, 3950, 1000);
    delay(5000);
    s("EMGY ACTV");

    // BUZZER WARNING_____________________
   bzwo ();
   // 1 sec
    while (2) {

 s("EMGY ACTV");
delay(1000);
 s(" SMS SENT");
delay(1000);

for (int i = 1; i <= 5; i++) {
      tone(bz, 3950, 25);         
    h ();
      }
  }
  }// To reactivating the loop need to physically reset the system using reset button.


  //GRND IRSR---------------------------------------------If actv automatic 1.5hr prss no physical contact needed.

  else if (gs == LOW ) 
    {
       // GSMm NOTF______________________
      r("GRND motr is now ACTV.");    
      delay(3000);               // delay for 3 seconds
      
      // OLED SCRN______________________
      s( "GRND STRT");

      // BUZZER WARNING_____________________
       bzwi ();         
      delay(500);               // delay for 500 miliseconds before activating.

       delay (2000);

      // GRND MOTR activated____________________
      digitalWrite (gr, LOW);     // Activating 220V AC MOTOR.
      delay(300000);              // 8 seconds of operating : for simulation purposes only
      // its may change for the actual testing on the site.
      // GRND MOTR deactivated__________________
      digitalWrite (gr, HIGH);   // deactivating 220V MOTOR.
      delay(500);                //  500 miliseconds delay.

      // GSMm NOTF______________________
      r("GRND motr is now Dactv.");
      delay(3000);

      // OLED SCRN_____________________
      s("GRND DONE");

      // BUZZER WARNING____________________
     bzwo ();          // 2.5 sec

      // GSMm NOTF_____________________
      for (int i = 1; i <= 3; i++) {
      r("GRND PRCS is DONE pls rmv 'ASAP'.");
        delay(600000); // 10 mins       
      }
    
    while (2) {
   s("GRND DONE");
 delay(1000);
  wl ();
      }
    }              // delay for 10mins\600000 / 5mins\300000

  //MNLO BOTN---------------------------------------------------------------------------------------------------------

  else if (mn == LOW) {
    // OLED SCRN_____________________
    s("MNLO INLZ");

    // GSMm NOTF_____________________
    r("Manual operation initialize.");
    delay(1500);

    // BUZZER WARNING____________________
   bzwi () ; // Buzzer intro tone
            // 1 sec delay


// OLED SCRN____________________
    s("COLL ACTV");

    // GSMm NOTF_____________________
    r("All electric motors are now activated.");
    
    // Activating COLL motr__________________
    digitalWrite (cl, LOW);   // activating 12V DC MOTOR
    delay(120000);             // 1 minute and 30 seconds delay before activating servo motor
    digitalWrite (cl, HIGH);  // deactivating 12V DC MOTOR
    s("COL DACTV");

    delay(5000);

    s("GRND STRT");

    // GRND MOTR is activated____________________
    digitalWrite (gr, LOW);   // activating 220V MOTOR

    // GSMm NOTF_____________________
    delay(300000);              // 5 minutes of operating : for simulation purposes only
    // its may change for the actual testing on the site.
    digitalWrite (gr, HIGH);  // deactivating 220V MOTOR

    delay(500);

    s("GRND DONE");

    // GSMm NOTF_____________________
    r("All eletric motors are now deactivated.");
    delay(3000);              // 2 sec delay

    // OLED SCRN_____________________
    s(" SMS SENT");
    tone(bz, 3950, 1000);
    delay(5000);
    s("MNLO DONE");

    // BUZZER WARNING____________________
    bzwo ();// Buzzer outro tone
               // 1 sec

    // GSMm NOTF SENTing 4 SMS notf every 2mins and 30 secs___________
    for (int i = 1; i <= 3; i++) {
      r("MNLO is now Dactv.");
      delay(60000);            //2mins 30secs\150000
      
    } while (2) {

  s("MNLO DONE");
 delay(1000);
  wl (); // warning loop 
      }
  }              
  //NO_PRCSS______________________
  else
  {
    digitalWrite (gr, HIGH);
    digitalWrite (cl, HIGH);
    s("NO PROCES");
    delay(1000);
    l();
  }
}

void r (String text)
{ sim.println("AT+CMGF=1\r");
  delay(200);                                                                                                      
  sim.println("AT+CMGS=\"" + defnum + "\"\r"); // Primary number 
  delay(1000);
  sim.println(text);
  delay(250);
  String prot = "Prototype testing please do not reply";
  sim.println (prot);
  sim.println((char)26); //sim.write(0x1A); //ascii code for ctrl-26 sim.println((char)26); //ascii code for ctrl-26
}
void s (String text)
{display.clearDisplay();
  display.setTextSize(2);
  display.setTextColor(WHITE);
  display.setCursor(10, 8 );
  display.print(text);
  display.display();}
void wl ()
{s(" SMS SENT");
tone(bz, 3950, 1000);
  h ();}
void bzwi () // Buzzer warning intro
{for (int i = 1; i <= 5; i++) {
      tone(bz, 3950, 500);
      delay(1000);}}
void bzwo () // Buzzer warning outro
{for (int i = 1; i <= 5; i++) {
      tone(bz, 3950, 800);
      delay(1000);}}
void l () //Loading Animation
{display.clearDisplay();
display.drawBitmap(50, 1,frame0 ,32,32, 1);
display.display();
delay(25);
display.clearDisplay();
display.drawBitmap(50, 1,frame1 ,32,32, 1);
display.display();
delay(25);
display.clearDisplay();
display.drawBitmap(50, 1,frame2 ,32,32, 1);
display.display();
delay(25);
display.clearDisplay();
display.drawBitmap(50, 1,frame3 ,32,32, 1);
display.display();
delay(25);
display.clearDisplay();
display.drawBitmap(50, 1,frame4 ,32,32, 1);
display.display();
delay(25);
display.clearDisplay();
display.drawBitmap(50, 1,frame5 ,32,32, 1);
display.display();
delay(25);
display.clearDisplay();
display.drawBitmap(50, 1,frame6 ,32,32, 1);
display.display();
delay(25);
display.clearDisplay();
display.drawBitmap(50, 1,frame7 ,32,32, 1);
display.display();
delay(25);
}

void h () // Hazard animation
{
display.clearDisplay();
display.drawBitmap(50, -5,hazard0,32,32, 1);
display.display();
delay(25);
display.clearDisplay();
display.drawBitmap(50, -5,hazard1,32,32, 1);
display.display();
delay(25);
display.clearDisplay();
display.drawBitmap(50, -5,hazard2,32,32, 1);
display.display();
delay(25);
display.clearDisplay();
display.drawBitmap(50, -5,hazard3,32,32, 1);
display.display();
delay(25);
display.clearDisplay();
display.drawBitmap(50, -5,hazard4,32,32, 1);
display.display();
delay(25);
display.clearDisplay();
display.drawBitmap(50, -5,hazard5,32,32, 1);
display.display();
delay(25);
display.clearDisplay();
display.drawBitmap(50, -5,hazard6,32,32, 1);
display.display();
delay(25);
}
